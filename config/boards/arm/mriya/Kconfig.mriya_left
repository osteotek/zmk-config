## config/boards/arm/mriya/Kconfig.mriya_left
```kconfig
# Copyright (c) 2023 Andrei Gaevskii
# SPDX-License-Identifier: MIT

config BOARD_MRIYA_LEFT
	select SOC_NRF52840_QIAA
	imply RETAINED_MEM
	imply RETENTION
	imply RETENTION_BOOT_MODE
```

## config/boards/arm/mriya/board.yml
```yaml
boards:
  - name: mriya_left
    vendor: mriya
    socs:
      - name: nrf52840
  - name: mriya_right
    vendor: mriya
    socs:
      - name: nrf52840
```

## config/boards/holyswitch/mriya/board.yml
```yaml
boards:
  - name: mriya_left
    vendor: holyswitch
    socs:
      - name: nrf52840
  - name: mriya_right
    vendor: holyswitch
    socs:
      - name: nrf52840
```
